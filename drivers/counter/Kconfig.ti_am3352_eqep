## drivers/counter/Kconfig.ti_am3352_eqep
```kconfig
# SPDX-FileCopyrightText: Copyright (c) 2026 Texas Instruments
# SPDX-License-Identifier: Apache-2.0

config COUNTER_TI_AM3352_EQEP
	bool "Whether to enable TI EQEP counter driver"
	default y
	depends on DT_HAS_TI_AM3352_EQEP_ENABLED
	depends on CLOCK_CONTROL
	select PINCTRL
	select MUX if DT_HAS_TI_AM13E230_XBAR_IN_ENABLED
	help
	  Enables the TI EQEP counter driver.
```

## drivers/mux/Kconfig.am13e_xbar
```kconfig
# SPDX-FileCopyrightText: 2026 Texas Instruments Incorporated
# SPDX-License-Identifier: Apache-2.0

config MUX_AM13E_XBAR
	bool "AM13E Input/Output Crossbar (XBAR) mux driver"
	default y
	depends on DT_HAS_TI_AM13E_XBAR_INPUT_ENABLED || DT_HAS_TI_AM13E_XBAR_OUTPUT_ENABLED
	help
	  Enable the AM13E Input Crossbar (INPUTXBAR) and Output Crossbar
	  (OUTPUTXBAR) mux driver.
```

## drivers/pinctrl/Kconfig.am13e
```kconfig
# SPDX-FileCopyrightText: 2026 Texas Instruments Incorporated
# SPDX-License-Identifier: Apache-2.0

config PINCTRL_AM13E
	bool "TI pinctrl AM13E driver"
	default y
	depends on DT_HAS_TI_AM13E_PINCTRL_ENABLED
```

## drivers/pwm/Kconfig.ti_am3352_ecap
```kconfig
# SPDX-FileCopyrightText: Copyright (c) 2026 Texas Instruments
# SPDX-License-Identifier: Apache-2.0

config PWM_TI_AM3352_ECAP
	bool "TI ECAP based PWM controller"
	default y
	depends on DT_HAS_TI_AM3352_ECAP_ENABLED
	select PINCTRL
	select MUX if DT_HAS_TI_AM13E_XBAR_INPUT_ENABLED || DT_HAS_TI_AM13E_XBAR_OUTPUT_ENABLED
	help
	  Enable ECAP controller for TI SoCs
```

## dts/bindings/counter/ti,am3352-eqep.yaml
```yaml
# SPDX-FileCopyrightText: Copyright (c) 2026 Texas Instruments
# SPDX-License-Identifier: Apache-2.0

description: |
  TI Enhanced Quadrature Encoder Pulse based counter

  On SoCs where the EQEP inputs are reachable only through a crossbar
  (e.g. AM13E), reference the Input X-BAR via "mux-states" instead of
  adding SoC-specific pinmux logic to this driver. Each EQEP input is
  hard-wired to a fixed Input X-BAR channel (EQEP0A = INPUT17 / channel
  16, and so on); the board or overlay routes a GPIO into that channel
  and names the entry:

    &eqep0 {
            pinctrl-0 = <&gpio_pb11>;
            pinctrl-names = "default";

            /* PB11 (GPIO43) -> INPUTXBAR17 (ch 16) -> EQEP0A */
            mux-states = <&xbar1 16 AM13E230_XBAR_IN_STATE(43, 1)>;
            mux-state-names = "qepa";
    };

  Presence of "mux-states" also selects the Input X-BAR as the EQEP
  source in QEPSRCSEL (AM13E-only), since that mux is internal to the
  EQEP and separate from the crossbar itself.

include: [base.yaml, pinctrl-device.yaml, mux-consumer.yaml]

compatible: "ti,am3352-eqep"

properties:
  reg:
    required: true

  interrupts:
    required: true
```

## dts/bindings/gpio/ti,mspm0-gpio.yaml
```yaml
# SPDX-License-Identifier: Apache-2.0

description: TI MSPM0 GPIO

compatible: "ti,mspm0-gpio"

include: [gpio-controller.yaml, base.yaml]

properties:
  reg:
    required: true

  interrupts:
    required: true

  "#gpio-cells":
    const: 2

  pinmux:
    type: phandles
    required: true
    description: |
      GPIO-function pinctrl nodes in pin order (index = pin number); each
      carries the pin's pinmux, applied via pinctrl_configure_pins(). A node
      with pinmux 0 marks a non-bonded pin.

  ti,xbar-gpio-base:
    type: int
    description: |
      GPIO number of this port's pin 0 in the device-wide GPIO numbering
      the Input X-BAR uses to select a source (e.g. port B pin 0 is
      GPIO32, so its base is 32). Consumers that capture a pin through the
      Input X-BAR (e.g. eCAP) add this base to the pin index to get the
      X-BAR source. Only needed on SoCs with an Input X-BAR (e.g. AM13E).

gpio-cells:
  - pin
  - flags
```

## dts/bindings/mux/ti,am13e-xbar-input.yaml
```yaml
# SPDX-FileCopyrightText: 2026 Texas Instruments Incorporated
# SPDX-License-Identifier: Apache-2.0

description: |
  TI AM13E Input Crossbar (INPUTXBAR).

  Routes a raw GPIO pin number onto one of the 28 input channels. Each
  channel has its own INPUTSELECT register holding the routed pin number
  (or the DRIVE_HIGH/DRIVE_LOW pseudo-pin sentinels 0xFE/0xFF).

  The single cell selects the input channel. The state value is the pin
  number routed onto that channel.

compatible: "ti,am13e-xbar-input"

include: [base.yaml, mux-controller.yaml]

properties:
  reg:
    required: true

  "#mux-control-cells":
    const: 1

  "#mux-state-cells":
    const: 2

mux-control-cells:
  - channel

mux-state-cells:
  - channel
  - pin

examples:
  - |
    inputxbar: input-xbar@40468000 {
            compatible = "ti,am13e-xbar-input";
            reg = <0x40468000 0x420>;
            #mux-control-cells = <1>;
            #mux-state-cells = <2>;
    };

    ecap1-capture-input {
            mux-states = <&inputxbar 0 36>; /* channel=0, pin=GPIO36 (PB4) */
    };
```

## dts/bindings/mux/ti,am13e-xbar-output.yaml
```yaml
# SPDX-FileCopyrightText: 2026 Texas Instruments Incorporated
# SPDX-License-Identifier: Apache-2.0

description: |
  TI AM13E Output Crossbar (OUTPUTXBAR).

  Routes one of the peripheral output sources onto one of the 12 output
  channels. Each output has a pair of one-hot source-select registers
  (G0SEL, G1SEL); at most one bit may be set across the pair at a time.

  The single cell selects the output. The state value encodes the source:
  bits [15:8] select the group (0 = G0SEL, 1 = G1SEL) and bits [7:0] select
  the one-hot bit within that register.

compatible: "ti,am13e-xbar-output"

include: [base.yaml, mux-controller.yaml]

properties:
  reg:
    required: true

  "#mux-control-cells":
    const: 1

  "#mux-state-cells":
    const: 2

mux-control-cells:
  - output

mux-state-cells:
  - output
  - source

examples:
  - |
    outputxbar: output-xbar@4046a000 {
            compatible = "ti,am13e-xbar-output";
            reg = <0x4046a000 0x400>;
            #mux-control-cells = <1>;
            #mux-state-cells = <2>;
    };

    ecap0-apwm-output {
            mux-states = <&outputxbar 8 0x08>; /* output=8, group=0 bit=8 */
    };
```

## dts/bindings/pinctrl/ti,am13e-pinctrl.yaml
```yaml
# SPDX-FileCopyrightText: 2026 Texas Instruments Incorporated
# SPDX-License-Identifier: Apache-2.0

description: |
    TI AM13E pinctrl node.

    Device pin configuration should be placed in the child nodes of this node.
    Populate the 'pinmux' field with a pair consisting of a PINCM index and
    its IO function, via the AM13E_PINMUX() macro.

    The node has the 'pinctrl' node label set in your SoC's devicetree,
    so you can modify it like this:

      &pinctrl {
              /* your modifications go here */
      };

    All device pin configurations should be placed in child nodes of the
    'pinctrl' node, as in the example below.

    Here is a list of supported standard pin properties:

    - bias-disable: Disable pull-up/down.
    - bias-pull-down: Enable pull-down resistor.
    - bias-pull-up: Enable pull-up resistor.
    - drive-open-drain: Output driver is open-drain.
    - drive-open-drain: Output driver is open-source.
    - drive-strength: Maximum current that can be sourced from the pin.
    - input-enable: enable input.
    - ti,invert: enable logical inversion of a digital input or output
    - ti,hysteresis: enable hysteresis control on open-drain pins

    Include the AM13E dt-bindings header in the board level DTS:

      #include <zephyr/dt-bindings/pinctrl/am13e-pinctrl.h>

    To change a pin's pinctrl default properties add a reference to the
    pin in the board's DTS file or in the project overlay and set the
    properties, e.g.:

      &pinctrl {
        ecap0_apwm_pb3: ecap0_apwm_pb3 {
          pinmux = <AM13E_PINMUX(36, AM13E_PIN_FUNCTION_8)>;
          input-enable;
        };
      };

    The PINCM index in the pinmux define is obtained from the device-specific
    datasheet/TRM pin table.

compatible: "ti,am13e-pinctrl"

include: base.yaml

properties:
  reg:
    required: true

child-binding:
  description: |
    This binding gives a base representation of the AM13E
    pins configuration.

  include:
    - name: pincfg-node.yaml
      property-allowlist:
        - bias-disable
        - bias-pull-down
        - bias-pull-up
        - bias-high-impedance
        - drive-open-drain
        - drive-open-source
        - drive-strength
        - input-enable

  properties:
    pinmux:
      required: true
      type: int
      description: |
        AM13E pin's configuration (PINCM index, IO function).

    drive-strength:
      enum:
        - 6
        - 20
      default: 6
      description: |
        The drive strength controls the maximum output drive strength sunk or
        sourced by an I/O pin.
          6: max 6 mA (SoC default)
          20: max 20 mA on high-drive capable IOs only (HDIO).

    ti,invert:
      type: boolean
      description: |
        Enables inversion of the input or output using the internal
        inversion capability of the GPIO

    ti,hysteresis:
      type: boolean
      description: |
        Enables the hysteresis control for access to CMOS logic
        (on open-drain capable pins)
```

## dts/bindings/pwm/ti,am3352-ecap.yaml
```yaml
# SPDX-FileCopyrightText: Copyright (c) 2026 Texas Instruments
# SPDX-License-Identifier: Apache-2.0

description: |
  TI SOC ECAP based PWM controller

  On SoCs where the eCAP's pins are reachable only through a crossbar
  (e.g. AM13E), the routing travels with the pin choice: the first entry
  of pinctrl-0 carries "ti,xbar-out" (APWM output) or "ti,xbar-in-gpio"
  (capture input) metadata, and the SoC devicetree sets the
  "ti,output-xbar"/"ti,input-xbar" device phandles plus the claimed
  "ti,inputxbar-channel" on the eCAP node. A board then only selects the
  route node:

    &ecap0 {
            pinctrl-0 = <&ecap0_out_pb3>;
            pinctrl-names = "default";
    };

    &ecap1 {
            pinctrl-0 = <&inputxbar_pb4>;
            pinctrl-names = "default";
    };

  A "ti,xbar-in-gpio" route additionally feeds this eCAP's own
  ECCTL0.INPUTSEL field with "ti,inputxbar-channel", since ECCTL0 is a
  mux internal to the eCAP, separate from the crossbar itself.

include: [pwm-controller.yaml, base.yaml, pinctrl-device.yaml]

compatible: "ti,am3352-ecap"

properties:
  reg:
    required: true

  interrupts:
    required: true

  clock-frequency:
    type: int
    description: Optional peripheral frequency to use if the clock is absent

  ti,output-xbar:
    type: phandle
    description: |
      Output X-BAR device routing this eCAP's APWM output to a pin
      (crossbar-routed SoCs only, e.g. AM13E). The route itself is taken
      from the "ti,xbar-out" metadata on the first entry of pinctrl-0.

  ti,input-xbar:
    type: phandle
    description: |
      Input X-BAR device routing a pin to this eCAP's capture input
      (crossbar-routed SoCs only, e.g. AM13E). The routed GPIO is taken
      from the "ti,xbar-in-gpio" metadata on the first entry of pinctrl-0.

  ti,inputxbar-channel:
    type: int
    description: |
      Input X-BAR channel this eCAP claims for its capture route. The
      channel is also written to ECCTL0.INPUTSEL, whose source table maps
      INPUTXBAR1-16 at indices 0-15, so only channels 0-15 are usable
      here. The SoC devicetree assigns a collision-free default per
      instance; boards only override on a conflict.

  "#pwm-cells":
    const: 3

pwm-cells:
  - channel
  - period
  - flags
```

## samples/drivers/counter/eqep_position_speed_index/Kconfig
```kconfig
# SPDX-FileCopyrightText: Copyright (c) 2026 Texas Instruments
# SPDX-License-Identifier: Apache-2.0

# Config for EQEP position/speed (index-window) sample.

config APP_EQEP_LINES_PER_REV
	int "Encoder lines per mechanical revolution"
	default 1500
	help
	  Number of quadrature lines per mechanical revolution. The decoder
	  uses 4x counting, so counts per revolution are four times this
	  value. The simulated index GPIO is pulsed once every this many
	  electrical periods. Default 1500 → 6000 counts/rev (AM13 SDK).

config APP_EQEP_ELECTRICAL_FREQ_HZ
	int "Simulated electrical frequency (Hz)"
	default 1250
	help
	  Rate of the software timer used to count electrical cycles for the
	  index pulse. Must match the external A/B stimulus frequency.
	  Default matches MCPWM period 19999 @ 50 MHz TBCLK (~800 us).

source "Kconfig.zephyr"
```

## samples/drivers/counter/ti_eqep_frequency/sample.yaml
```yaml
sample:
  name: TI EQEP frequency measurement
common:
  tags:
    - drivers
    - counter
  depends_on:
    - counter
    - gpio
  filter: dt_alias_exists("eqep0") and dt_compat_enabled("ti,am3352-eqep")
tests:
  sample.drivers.counter.ti_eqep_frequency:
    platform_allow:
      - lp_am13e230
    integration_platforms:
      - lp_am13e230
    harness: console
    harness_config:
      fixture: gpio_loopback
      type: multi_line
      ordered: true
      regex:
        - "TI EQEP frequency measurement sample"
        - "measured 100 Hz"
```
